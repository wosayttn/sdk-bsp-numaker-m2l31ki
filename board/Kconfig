## board/Kconfig
```kconfig
menu "Hardware Drivers Config"

    menu "On-chip Peripheral Drivers"
        source "./libraries/m2l31/rtt_port/Kconfig"
    endmenu

    menu "On-board Peripheral Drivers"

        config BOARD_USING_NULINKME
            bool "Enable UART0 for RTT Console.(uart0)"
            select BSP_USING_UART
            select BSP_USING_UART0
            default y

        config BSP_USING_CUSTOM_LOADER
            bool "Enable Custom Loader for Swapping Flash Bank."
            select BSP_USING_RMC

        choice
            prompt "Select FS USB Ports"

            config BOARD_USING_USBD
                select BSP_USING_USBD
                bool "Enable USBD(over USB1.1)"
                help
                    Choose this option if you need USBD function mode.

            config BOARD_USING_USBH
                select BSP_USING_USBH
                bool "Enable USBH(over USB1.1)"
                help
                    Choose this option if you need USBH function mode.

            config BOARD_USING_USB_NONE
                select BSP_USING_USB_NONE
                bool "Disable USB1.1 port"
                help
                    Choose this option if you need not USB function.

        endchoice


    endmenu

    menu "Board extended module drivers"

        config BOARD_USING_NUTFT
            bool "Nu_TFT V1.3"
            default n

        if BOARD_USING_NUTFT

            config BOARD_USING_LCD_ILI9341
                bool "Enable LCM(Over USCI0)"
                select BSP_USING_USCI
                select BSP_USING_USCI0
                select BSP_USING_USPI0
                select NU_PKG_USING_ILI9341
                select NU_PKG_USING_ILI9341_SPI
                select NU_PKG_ILI9341_WITH_OFFSCREEN_FRAMEBUFFER
                select NU_PKG_ILI9341_HORIZONTAL
                default y

                if BOARD_USING_LCD_ILI9341

                    config BOARD_USING_ILI9341_PIN_BACKLIGHT
                    int "Specify the pin index of backlight pin index"
                        range 0 127
                        default 11

                    config BOARD_USING_ILI9341_PIN_RESET
                    int "Specify the pin index of reset pin index"
                        range 0 127
                        default 9

                    config BOARD_USING_ILI9341_PIN_DC
                    int "Specify the pin index of data&command switching"
                        range 0 127
                        default 8

                endif

            config BOARD_USING_NUTFT_ADC_TOUCH
                bool "Enable ADC Touching(Over EADC0)"
                select BSP_USING_EADC
                select BSP_USING_EADC0
                select RT_USING_TOUCH
                select NU_PKG_USING_ADC_TOUCH
                select NU_PKG_USING_ADC_TOUCH_SW
                default y

            config BOARD_USING_NUTFT_QSPI_FLASH
                bool "Enable QSPI Flash(Over QSPI0)"
                select BSP_USING_SPI
                select BSP_USING_QSPI
                select BSP_USING_QSPI0
                select RT_USING_FAL
                select RT_USING_SFUD
                default y

            config BOARD_USING_NUTFT_BUTTON
                bool "Enable BUTTON(UNO_A4, UNO_A5)"
                select RT_USING_PIN
                default y
        endif

    endmenu

    source "./libraries/nu_packages/Kconfig"

endmenu
```
